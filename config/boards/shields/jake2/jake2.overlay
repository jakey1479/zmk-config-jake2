
#include <dt-bindings/zmk/matrix_transform.h>

/ {
    chosen {
        zmk,kscan = &default_kscan;
        zmk,matrix_transform = &default_transform;
    };

    default_kscan: kscan {
        compatible = "zmk,kscan-gpio-matrix";
        label = "default_kscan";
        diode-direction = "col2row";

        col-gpios = <&gpio1 1 GPIO_ACTIVE_HIGH>,   /* P1.01 */
                    <&gpio1 2 GPIO_ACTIVE_HIGH>,   /* P1.02 */
                    <&gpio0 29 GPIO_ACTIVE_HIGH>,  /* P0.29 */
                    <&gpio1 13 GPIO_ACTIVE_HIGH>,  /* P1.13 */
                    <&gpio0 6 GPIO_ACTIVE_HIGH>,   /* P0.06 */
                    <&gpio0 8 GPIO_ACTIVE_HIGH>,   /* P0.08 */
                    <&gpio0 31 GPIO_ACTIVE_HIGH>,  /* P0.31 */
                    <&gpio0 22 GPIO_ACTIVE_HIGH>,  /* P0.22 */
                    <&gpio0 2 GPIO_ACTIVE_HIGH>,   /* P0.02 */
                    <&gpio0 9 GPIO_ACTIVE_HIGH>,   /* P0.09 */
                    <&gpio1 11 GPIO_ACTIVE_HIGH>,  /* P1.11 */
                    <&gpio0 17 GPIO_ACTIVE_HIGH>,  /* P0.17 */
                    <&gpio0 10 GPIO_ACTIVE_HIGH>,  /* P0.10 */
                    <&gpio0 20 GPIO_ACTIVE_HIGH>,  /* P0.20 */
                    <&gpio1 15 GPIO_ACTIVE_HIGH>;  /* P1.15 */

        row-gpios = <&gpio0 24 GPIO_ACTIVE_HIGH>,  /* P0.24 */
                    <&gpio0 11 GPIO_ACTIVE_HIGH>,  /* P0.11 */
                    <&gpio1 4  GPIO_ACTIVE_HIGH>,  /* P1.04 */
                    <&gpio1 0  GPIO_ACTIVE_HIGH>,  /* P1.00 */
                    <&gpio1 6  GPIO_ACTIVE_HIGH>;  /* P1.06 */
    };

    default_transform: transform_5x15 {
        compatible = "zmk,matrix-transform";
        rows = <0 1 2 3 4>;
        columns = <0 1 2 3 4 5 6 7 8 9 10 11 12 13 14>;
    };
};
