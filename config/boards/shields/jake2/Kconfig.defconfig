## config/boards/shields/jake2/Kconfig.defconfig
```kconfig
if SHIELD_JAKE2

config ZMK_KEYBOARD_NAME
    default "jake2"

CONFIG_ZMK_BACKLIGHT=y
CONFIG_ZMK_BACKLIGHT_BRT_STEP=20
CONFIG_ZMK_BACKLIGHT_BRT_START=40
CONFIG_ZMK_BACKLIGHT_ON_START=y
CONFIG_ZMK_BACKLIGHT_AUTO_OFF_IDLE=n
CONFIG_ZMK_BACKLIGHT_AUTO_OFF_USB=n

endif

if ZMK_BACKLIGHT

config PWM
    default y

config LED_PWM
    default y

endif # ZMK_BACKLIGHT
```

## config/boards/shields/jake2/Kconfig.shield
```kconfig
config SHIELD_JAKE2
    def_bool $(shields_list_contains,jake2)
    CONFIG_CLOCK_CONTROL_NRF_K32SRC_RC=y
```
